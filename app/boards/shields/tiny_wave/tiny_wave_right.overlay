// tiny_wave_right.overlay

#include "tiny_wave.dtsi" // Notice that the main dtsi files are included in the overlay.

&default_transform { // The matrix transform for this board is 7 columns over because the left half is 6 columns wide according to the matrix.
    col-offset = <7>;
};

&kscan0 {
    col-gpios
        = <&pro_micro  9 GPIO_ACTIVE_HIGH>
        , <&pro_micro  8 GPIO_ACTIVE_HIGH>
        , <&pro_micro 10 GPIO_ACTIVE_HIGH>
        , <&pro_micro 16 GPIO_ACTIVE_HIGH>
        , <&pro_micro 14 GPIO_ACTIVE_HIGH>
        , <&pro_micro 15 GPIO_ACTIVE_HIGH>
        , <&pro_micro 18 GPIO_ACTIVE_HIGH>
        ;
};

/* &pro_micro_i2c { */
/* 	status = "okay"; */
/* 	trackball_pim447@a { */
/* 		compatible = "pimoroni,trackball_pim447"; */
/* 		reg = <0xa>; */
/* 		label = "TRACKBALL_PIM447"; */
/*     swap_axes = y; */
/* 	}; */
/* }; */
