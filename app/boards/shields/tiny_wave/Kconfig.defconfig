## app/boards/shields/tiny_wave/Kconfig.defconfig
```kconfig
if SHIELD_TINY_WAVE_RIGHT

config ZMK_KEYBOARD_NAME
    default "Tiny Wave"

config ZMK_SPLIT_ROLE_CENTRAL
    default y

endif

if SHIELD_TINY_WAVE_LEFT || SHIELD_TINY_WAVE_RIGHT

config ZMK_SPLIT
    default y

endif
```

## app/boards/shields/tiny_wave/Kconfig.shield
```kconfig
config SHIELD_TINY_WAVE_LEFT
    def_bool $(shields_list_contains,tiny_wave_left)

config SHIELD_TINY_WAVE_RIGHT
    def_bool $(shields_list_contains,tiny_wave_right)
```
